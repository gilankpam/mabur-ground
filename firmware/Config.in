## firmware/Config.in
```kconfig
source "$BR2_EXTERNAL_MABUR_GS_PATH/package/aic8800/Config.in"
source "$BR2_EXTERNAL_MABUR_GS_PATH/package/librga/Config.in"
source "$BR2_EXTERNAL_MABUR_GS_PATH/package/rockchip-mpp/Config.in"
source "$BR2_EXTERNAL_MABUR_GS_PATH/package/ffmpeg-v4l2request/Config.in"
source "$BR2_EXTERNAL_MABUR_GS_PATH/package/devourer/Config.in"
source "$BR2_EXTERNAL_MABUR_GS_PATH/package/mabur/Config.in"

choice
    prompt "GPIO configuration method"
    help
      Select how to configure the gadget mode GPIO detection.

config BR2_BOARD_GPIO_CONFIG_CHIP_LINE
    bool "Use GPIO chip and line"
    help
      Specify GPIO using chip name and line number.

config BR2_BOARD_GPIO_CONFIG_PIN_NAME
    bool "Use GPIO pin name"
    help
      Specify GPIO using pin name.

endchoice

config BR2_FACTORY_RESET_GPIO_CHIP
    string "Factory reset GPIO chip"
    default ""
    depends on BR2_BOARD_GPIO_CONFIG_CHIP_LINE
    help
      When detected high during boot (initrd phase) issue a factory reset.

config BR2_FACTORY_RESET_GPIO_LINE
    string "Factory reset GPIO line"
    default ""
    depends on BR2_BOARD_GPIO_CONFIG_CHIP_LINE
    help
      When detected high during boot (initrd phase) issue a factory reset.

config BR2_FACTORY_RESET_GPIO_PIN_NAME
    string "Factory reset GPIO pin name"
    default ""
    depends on BR2_BOARD_GPIO_CONFIG_PIN_NAME
    help
      When detected high during boot (initrd phase) issue a factory reset.

config BR2_GADGET_MODE_GPIO_CHIP
    string "Gadget mode GPIO chip"
    default ""
    depends on BR2_BOARD_GPIO_CONFIG_CHIP_LINE
    help
      Starts gadget mode when detected high during boot (initrd phase).

config BR2_GADGET_MODE_GPIO_LINE
    string "Gadget mode GPIO line"
    default ""
    depends on BR2_BOARD_GPIO_CONFIG_CHIP_LINE
    help
      Starts gadget mode when detected high during boot (initrd phase).

config BR2_GADGET_MODE_GPIO_PIN_NAME
    string "Gadget mode GPIO pin name"
    default ""
    depends on BR2_BOARD_GPIO_CONFIG_PIN_NAME
    help
      Starts gadget mode when detected high during boot (initrd phase).
```
